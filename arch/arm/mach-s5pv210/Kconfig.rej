## arch/arm/mach-s5pv210/Kconfig.rej
```kconfig
--- arch/arm/mach-s5pv210/Kconfig
+++ arch/arm/mach-s5pv210/Kconfig
@@ -25,14 +25,6 @@
         help
           Enable DEEP IDLE support for S5PV210 CPU.
 
-config BT_SLEEP_ENABLER
-	bool "Enable BT SLEEP while in Deep Idle support for S5PV210 CPU"
-	depends on CPU_IDLE
-	default  y
-	help
-	  Enable BT SLEEP while in Deep Idle support for S5PV210 CPU.
-	  This is to Avoid BT Staying in Sleep Mode or Not Enter Sleep at all.
-
 config S5PV210_BIGMEM
 	bool "Enable Bigmem (more free RAM)"
 	default n
```
